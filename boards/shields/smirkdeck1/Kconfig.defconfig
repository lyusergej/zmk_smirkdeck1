## boards/shields/smirkdeck1/Kconfig.defconfig
```kconfig
# SPDX-License-Identifier: MIT

if SHIELD_SMIRKDECK

config ZMK_KEYBOARD_NAME
    default "smirkdeck1"

endif
```

## boards/shields/smirkdeck1/Kconfig.shield
```kconfig
config SHIELD_SMIRKDECK
    def_bool $(shields_list_contains,smirkdeck1)
    select SPI
```

## config/boards/shields/smirkdeck1/Kconfig.defconfig
```kconfig
# Copyright (c) 2020 The ZMK Contributors
# SPDX-License-Identifier: MIT

if SHIELD_smirkdeck1

config ZMK_KEYBOARD_NAME
    default "smirkdeck1"

endif
```

## config/boards/shields/smirkdeck1/Kconfig.shield
```kconfig
# Copyright (c) 2020 The ZMK Contributors
# SPDX-License-Identifier: MIT

config SHIELD_smirkdeck1
    def_bool $(shields_list_contains,smirkdeck1)
```
